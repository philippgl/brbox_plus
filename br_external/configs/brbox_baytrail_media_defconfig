## br_external/configs/brbox_baytrail_media_defconfig
```kconfig
BR2_x86_64=y
BR2_x86_corei7=y
BR2_DL_DIR="$(BR2_EXTERNAL)/../dl"
BR2_KERNEL_HEADERS_VERSION=y
BR2_DEFAULT_KERNEL_VERSION="3.18.4"
BR2_PACKAGE_HOST_LINUX_HEADERS_CUSTOM_3_18=y
BR2_TOOLCHAIN_BUILDROOT_GLIBC=y
BR2_GCC_VERSION_4_8_X=y
BR2_TOOLCHAIN_BUILDROOT_CXX=y
BR2_TARGET_GENERIC_HOSTNAME=""
BR2_TARGET_GENERIC_ISSUE="Welcome to BrBox"
BR2_ROOTFS_DEVICE_CREATION_DYNAMIC_EUDEV=y
BR2_TARGET_GENERIC_ROOT_PASSWD="root"
BR2_TARGET_GENERIC_GETTY_PORT="tty1"
# BR2_TARGET_GENERIC_REMOUNT_ROOTFS_RW is not set
BR2_ROOTFS_OVERLAY="$(BR2_EXTERNAL)/board/rootfs_overlay/"
BR2_ROOTFS_POST_BUILD_SCRIPT="$(BR2_EXTERNAL)/board/brbox/post_build.sh"
BR2_LINUX_KERNEL=y
BR2_LINUX_KERNEL_CUSTOM_VERSION=y
BR2_LINUX_KERNEL_CUSTOM_VERSION_VALUE="3.18.4"
BR2_LINUX_KERNEL_USE_CUSTOM_CONFIG=y
BR2_LINUX_KERNEL_CUSTOM_CONFIG_FILE="$(BR2_EXTERNAL)/board/brbox/baytrail-media/linux.config"
BR2_LINUX_KERNEL_INSTALL_TARGET=y
BR2_PACKAGE_BUSYBOX_CONFIG="$(BR2_EXTERNAL)/board/brbox/baytrail-media/busybox.config"
BR2_PACKAGE_GSTREAMER1=y
BR2_PACKAGE_GST1_PLUGINS_BASE_PLUGIN_VIDEOCONVERT=y
BR2_PACKAGE_GST1_PLUGINS_GOOD=y
BR2_PACKAGE_GST1_PLUGINS_GOOD_PLUGIN_MATROSKA=y
BR2_PACKAGE_GST1_PLUGINS_GOOD_PLUGIN_RTP=y
BR2_PACKAGE_GST1_PLUGINS_GOOD_PLUGIN_RTPMANAGER=y
BR2_PACKAGE_GST1_PLUGINS_GOOD_PLUGIN_RTSP=y
BR2_PACKAGE_GST1_PLUGINS_GOOD_PLUGIN_UDP=y
BR2_PACKAGE_GST1_PLUGINS_GOOD_PLUGIN_VIDEOMIXER=y
BR2_PACKAGE_GST1_PLUGINS_GOOD_PLUGIN_V4L2=y
BR2_PACKAGE_GST1_PLUGINS_BAD=y
BR2_PACKAGE_GST1_PLUGINS_BAD_LIB_OPENGL=y
BR2_PACKAGE_GST1_PLUGINS_BAD_PLUGIN_MPEGTSDEMUX=y
BR2_PACKAGE_GST1_PLUGINS_BAD_PLUGIN_VIDEOPARSERS=y
BR2_PACKAGE_GST1_PLUGINS_BAD_PLUGIN_FBDEV=y
BR2_PACKAGE_GST1_PLUGINS_UGLY=y
BR2_PACKAGE_GST1_LIBAV=y
BR2_PACKAGE_STRESS=y
BR2_PACKAGE_E2FSPROGS=y
BR2_PACKAGE_DIRECTFB=y
BR2_PACKAGE_MESA3D=y
BR2_PACKAGE_MESA3D_DRI_DRIVER_I915=y
BR2_PACKAGE_MESA3D_DRI_DRIVER_I965=y
BR2_PACKAGE_MESA3D_OPENGL_EGL=y
BR2_PACKAGE_MESA3D_OPENGL_ES=y
BR2_PACKAGE_XORG7=y
BR2_PACKAGE_XLIB_LIBXRANDR=y
BR2_PACKAGE_LIBVA_INTEL_DRIVER=y
BR2_PACKAGE_LIBCGICC=y
BR2_PACKAGE_LIBPCAP=y
BR2_PACKAGE_LIBWEBSOCKETS=y
BR2_PACKAGE_AVAHI=y
# BR2_PACKAGE_AVAHI_AUTOIPD is not set
BR2_PACKAGE_AVAHI_DAEMON=y
BR2_PACKAGE_DROPBEAR=y
BR2_PACKAGE_ETHTOOL=y
BR2_PACKAGE_IPERF=y
BR2_PACKAGE_LIGHTTPD=y
BR2_PACKAGE_LIGHTTPD_PCRE=y
BR2_PACKAGE_FILE=y
BR2_TARGET_ROOTFS_EXT2=y
BR2_TARGET_ROOTFS_EXT2_3=y
BR2_TARGET_ROOTFS_EXT2_XZ=y
BR2_TARGET_ROOTFS_TAR_XZ=y
BR2_TARGET_GRUB2=y
BR2_BRBOX_DISKSIZE="356M"
BR2_BRBOX_PARTITIONSIZE="134M"
BR2_TARGET_BRBOX_PACKAGES=y
BR2_TARGET_BRBOX_COMMON=y
BR2_PACKAGE_HOST_BRBOX_MKIMAGE=y
BR2_PACKAGE_BRBOX_BAYTRAIL_UPDATE=y
BR2_PACKAGE_BRBOX_BAYTRAIL_MOUNT=y
BR2_PACKAGE_BRBOX_GSTREAMER_VAAPI=y
```

## br_external/package/Config.in
```kconfig
menu "BrBox Packages"

menu "Disk Image Settings"

config BR2_BRBOX_DISKSIZE
    string "Size of the disk image"
    default "256M"
    help
        Size of the generated disk image

config BR2_BRBOX_PARTITIONSIZE
    string "Size of the partition image"
    default "104M"
    help
        Size of a root partition 
        Has to be smaller than half the IMAGESIZE

config BR2_BRBOX_ROOTFS_TYPE
    string "Rootfs type for the brbox-mkimage"
    default "BrBoxRtBtr"
    help
        Taken from brbox-mkimage/image.h
        Available Options are: 
        "BrBoxRtBtr" //root-fs bay-trail
        "BrBoxRtRp1" //root-fs raspi1
        "BrBoxRtRp2" //root-fs raspi2
        "BrBoxRtBbb" //root-fs beagle-bone-black
        "BrBoxRtWdb" //root-fs wandboard

endmenu

config BR2_TARGET_BRBOX_PACKAGES
        bool "BrBox Related packages"
	default n
        help
          Enable building of all BrBox related packages

config BR2_TARGET_BRBOX_SVNURL
        string "base svn location of BrBox Packages"
	default "http://github.com/hackboxguy/brbox/trunk"
        depends on BR2_TARGET_BRBOX_PACKAGES
        help
          From which svn location to checkout the sources during build process

config BR2_TARGET_BRBOX_COMMON
        bool "Common packages"
	depends on BR2_TARGET_BRBOX_PACKAGES
        help
          Enable building of common (non-board-specific) packages

if BR2_TARGET_BRBOX_COMMON
menu "Common packages"
source "$BR2_EXTERNAL/package/brbox_libAdSttngs/Config.in"
source "$BR2_EXTERNAL/package/brbox_libAdCmnOld/Config.in"
source "$BR2_EXTERNAL/package/brbox_mkimage/Config.in"
source "$BR2_EXTERNAL/package/brbox_sysmgr/Config.in"
source "$BR2_EXTERNAL/package/brbox_finddevtype/Config.in"
source "$BR2_EXTERNAL/package/brbox_defhostname/Config.in"
source "$BR2_EXTERNAL/package/brbox_huawei_e173udevrule/Config.in"
source "$BR2_EXTERNAL/package/brbox_libgammu/Config.in"
source "$BR2_EXTERNAL/package/brbox_libgloox/Config.in"
source "$BR2_EXTERNAL/package/brbox_libonion/Config.in"
endmenu
endif


source "$BR2_EXTERNAL/package/brbox_baytrail_update/Config.in"
source "$BR2_EXTERNAL/package/brbox_baytrail_mount/Config.in"
source "$BR2_EXTERNAL/package/brbox_I210kmodAvbIgb/Config.in"
source "$BR2_EXTERNAL/package/brbox_raspi2_update/Config.in"
source "$BR2_EXTERNAL/package/brbox_raspi2_mount/Config.in"
source "$BR2_EXTERNAL/package/brbox_bbb_update/Config.in"
source "$BR2_EXTERNAL/package/brbox_bbbmmc_update/Config.in"
source "$BR2_EXTERNAL/package/brbox_bbb_mount/Config.in"
source "$BR2_EXTERNAL/package/brbox_bbbmmc_mount/Config.in"
source "$BR2_EXTERNAL/package/brbox_gpiomgr/Config.in"
source "$BR2_EXTERNAL/package/brbox_smarteye/Config.in"
source "$BR2_EXTERNAL/package/brbox_bboxsms/Config.in"
source "$BR2_EXTERNAL/package/brbox_xmproxy/Config.in"
source "$BR2_EXTERNAL/package/brbox_apisrv/Config.in"
source "$BR2_EXTERNAL/package/brbox_gstreamer_vaapi/Config.in"
endmenu
```
